## CMakeLists.txt
```
# SPDX-License-Identifier: Apache-2.0

cmake_minimum_required(VERSION 3.20.0)
find_package(Zephyr REQUIRED HINTS $ENV{ZEPHYR_BASE})
project(mcap_sample)

FILE(GLOB app_sources src/*.c)
target_sources(app PRIVATE ${app_sources})
```

## Kconfig
```
#
# Copyright (c) 2023 Nordic Semiconductor ASA
# Copyright (c) 2023 Antmicro <www.antmicro.com>
#
# SPDX-License-Identifier: Apache-2.0
#

mainmenu "MCAP Sample Application"

config FS_SAMPLE_CREATE_SOME_ENTRIES
	bool "When no files are found on mounted partition create some"
	default y
	help
	  In case when no files could be listed, because there are none,
	  "some.dir" directory and "other.txt" file will be created
	  and list will run again to show them. This is useful when
	  showing how file system works on non-SD devices like internal
	  flash or (Q)SPI connected memories, where it is not possible to
	  easily add files with use of other device.

source "Kconfig.zephyr"


module = MCAP_SAMPLE
module-str = MCAP_SAMPLE
source "subsys/logging/Kconfig.template.log_config"
```

## prj.conf
```kconfig
CONFIG_DISK_ACCESS=y
CONFIG_LOG=y
CONFIG_FILE_SYSTEM=y
CONFIG_FILE_SYSTEM_EXT2=y

CONFIG_PRINTK=y
CONFIG_MAIN_STACK_SIZE=2048
CONFIG_MCAP_SAMPLE_LOG_LEVEL_DBG=y
```

## boards/native_sim.overlay
```dts
/*
 * Copyright (c) 2024 Russ Webber
 */

/ {
    chosen {
        // zephyr,canbus = &can0;
    };
};

/*&can0 {
    status = "okay";
    // compatible = "zephyr,native-posix-linux-can";
    host-interface = "vcan0";
    // sjw = <1>;
    // sample-point = <875>;
    // bus-speed = <125000>;
};*/
```

## src/main.c
```c
/*
 * Copyright (c) 2019 Tavish Naruka <tavishnaruka@gmail.com>
 * Copyright (c) 2023 Nordic Semiconductor ASA
 * Copyright (c) 2023 Antmicro <www.antmicro.com>
 *
 * SPDX-License-Identifier: Apache-2.0
 */

/* Sample which uses the filesystem API and SDHC driver */

#include <zephyr/kernel.h>
#include <zephyr/device.h>
#include <zephyr/storage/disk_access.h>
#include <zephyr/logging/log.h>
#include <zephyr/fs/fs.h>

#include "mcap.h"

#if defined(CONFIG_FAT_FILESYSTEM_ELM)

#include <ff.h>

/*
 *  Note the fatfs library is able to mount only strings inside _VOLUME_STRS
 *  in ffconf.h
 */
#define DISK_DRIVE_NAME "SD"
#define DISK_MOUNT_PT "/"DISK_DRIVE_NAME":"

static FATFS fat_fs;
/* mounting info */
static struct fs_mount_t mp = {
	.type = FS_FATFS,
	.fs_data = &fat_fs,
};

#elif defined(CONFIG_FILE_SYSTEM_EXT2)

#include <zephyr/fs/ext2.h>

#define DISK_DRIVE_NAME "SDMMC"
#define DISK_MOUNT_PT "/ext"

static struct fs_mount_t mp = {
	.type = FS_EXT2,
	.flags = FS_MOUNT_FLAG_NO_FORMAT,
	.storage_dev = (void *)DISK_DRIVE_NAME,
	.mnt_point = "/ext",
};

#endif

LOG_MODULE_REGISTER(main);

#define MAX_PATH 128
#define SOME_FILE_NAME "example.mcap"
#define SOME_DIR_NAME "some"
#define SOME_REQUIRED_LEN MAX(sizeof(SOME_FILE_NAME), sizeof(SOME_DIR_NAME))

static int lsdir(const char *path);
static bool create_some_entries(const char *base_path)
{
	char path[MAX_PATH];
	struct fs_file_t file;
	int base = strlen(base_path);

	fs_file_t_init(&file);

	if (base >= (sizeof(path) - SOME_REQUIRED_LEN)) {
		LOG_ERR("Not enough concatenation buffer to create file paths");
		return false;
	}

	LOG_INF("Creating some dir entries in %s", base_path);
	strncpy(path, base_path, sizeof(path));

	path[base++] = '/';
	path[base] = 0;
	strcat(&path[base], SOME_FILE_NAME);

	if (fs_open(&file, path, FS_O_CREATE) != 0) {
		LOG_ERR("Failed to create file %s", path);
		return false;
	}
	fs_close(&file);

	return true;
}

static const char *disk_mount_pt = DISK_MOUNT_PT;

int main(void)
{
	/* raw disk i/o */
	do {
		static const char *disk_pdrv = DISK_DRIVE_NAME;
		uint64_t memory_size_mb;
		uint32_t block_count;
		uint32_t block_size;

		if (disk_access_init(disk_pdrv) != 0) {
			LOG_ERR("Storage init ERROR!");
			break;
		}

		if (disk_access_ioctl(disk_pdrv,
				DISK_IOCTL_GET_SECTOR_COUNT, &block_count)) {
			LOG_ERR("Unable to get sector count");
			break;
		}
		LOG_INF("Block count %u", block_count);

		if (disk_access_ioctl(disk_pdrv,
				DISK_IOCTL_GET_SECTOR_SIZE, &block_size)) {
			LOG_ERR("Unable to get sector size");
			break;
		}
		printk("Sector size %u\n", block_size);

		memory_size_mb = (uint64_t)block_count * block_size;
		printk("Memory Size(MB) %u\n", (uint32_t)(memory_size_mb >> 20));
	} while (0);

	mp.mnt_point = disk_mount_pt;

	int res = fs_mount(&mp);

#if defined(CONFIG_FAT_FILESYSTEM_ELM)
	if (res == FR_OK) {
#else
	if (res == 0) {
#endif
		printk("Disk mounted.\n");
		if (lsdir(disk_mount_pt) == 0) {
			if (create_some_entries(disk_mount_pt)) {
				lsdir(disk_mount_pt);
			}
		}
	} else {
		printk("Error mounting disk.\n");
	}



	fs_unmount(&mp);

	while (1) {
		k_sleep(K_MSEC(1000));
	}
	return 0;
}

/* List dir entry by path
 *
 * @param path Absolute path to list
 *
 * @return Negative errno code on error, number of listed entries on
 *         success.
 */
static int lsdir(const char *path)
{
	int res;
	struct fs_dir_t dirp;
	static struct fs_dirent entry;
	int count = 0;

	fs_dir_t_init(&dirp);

	/* Verify fs_opendir() */
	res = fs_opendir(&dirp, path);
	if (res) {
		printk("Error opening dir %s [%d]\n", path, res);
		return res;
	}

	printk("\nListing dir %s ...\n", path);
	for (;;) {
		/* Verify fs_readdir() */
		res = fs_readdir(&dirp, &entry);

		/* entry.name[0] == 0 means end-of-dir */
		if (res || entry.name[0] == 0) {
			break;
		}

		if (entry.type == FS_DIR_ENTRY_DIR) {
			printk("[DIR ] %s\n", entry.name);
		} else {
			printk("[FILE] %s (size = %zu)\n",
				entry.name, entry.size);
		}
		count++;
	}

	/* Verify fs_closedir() */
	fs_closedir(&dirp);
	if (res == 0) {
		res = count;
	}

	return res;
}
```

## src/mcap.c
```c
#include "mcap.h"

#include <zephyr/sys/byteorder.h>
#include <zephyr/logging/log.h>
#include <string.h>

const uint8_t MCAP_MAGIC[] = {0x89, 'M', 'C', 'A', 'P', 0x30, 0x1A, 0x0A};
const char MCAP_LIBRARY[] = "zephyr-mcap";

#define MCAP_TYPE_HEADER 0x01
#define MCAP_TYPE_FOOTER 0x02
#define MCAP_TYPE_SCHEMA 0x03
#define MCAP_TYPE_CHANNEL 0x04
#define MCAP_TYPE_MESSAGE 0x05
#define MCAP_TYPE_CHUNK 0x06
#define MCAP_TYPE_MESSAGE_INDEX 0x07
#define MCAP_TYPE_CHUNK_INDEX 0x08
#define MCAP_TYPE_ATTACHMENT 0x09
#define MCAP_TYPE_METADATA 0x0C
#define MCAP_TYPE_DATA_END 0x0F
#define MCAP_TYPE_ATTACHMENT_INDEX 0x0A
#define MCAP_TYPE_METADATA_INDEX 0x0D
#define MCAP_TYPE_STATISTICS 0x0B
#define MCAP_TYPE_SUMMARY_OFFSET 0x0E

LOG_MODULE_REGISTER(mcap_sample, CONFIG_MCAP_SAMPLE_LOG_LEVEL);


void example_mcap_stream() {
    struct fs_file_t file;
    int rc;

    fs_file_t_init(&file);
    char* fname = "test.mcap";
    rc = fs_open(&file, fname, FS_O_CREATE | FS_O_WRITE);
    if (rc < 0) {
        LOG_ERR("FAIL: open %s: %d", fname, rc);
//        return rc;
    }

//    LOG_PRINTK("%s write new boot count %u: [wr:%d]\n", fname,
//               boot_count, rc);

    struct mcap_file_t mcap_file = mcap_init(&file);
    
    uint16_t schema_id = mcap_add_schema(&mcap_file, "sensor_data", "text", NULL, 0);

    struct mcap_metadata_t chan1_metadata;
//    = {
//        {"key1", "value1"},
//        {"key2", "value2"}
//    };

    uint16_t chan1 = mcap_add_channel(&mcap_file, schema_id,
                                      "channel1", "nmea0183", &chan1_metadata);

    char msg_data_buffer[] = "Hello, World! XX";

    for (uint32_t i = 0; i < 10; i++) {
        uint64_t timestamp = 1000 * i;

        msg_data_buffer[14] = '0' + i / 10;
        msg_data_buffer[15] = '0' + i % 10;
        mcap_write_message(&mcap_file, chan1, i,
                           timestamp, timestamp, msg_data_buffer, sizeof(msg_data_buffer));
    }

    mcap_finish(&mcap_file);
    fs_close(&file);
}

uint32_t mcap_string_length(const char* str) {
    return strlen(str) + sizeof(uint32_t);
}

struct mcap_file_t mcap_init(struct fs_file_t* fd) {
    struct mcap_file_t mcap_file = {
            .fd = fd,
            .fd_offset = 0,
            .statistics = {
                    .message_count = 0,
                    .schema_count = 0,
                    .channel_count = 0,
                    .attachment_count = 0,
                    .metadata_count = 0,
                    .chunk_count = 0,
                    .message_start_time = 0,
                    .message_end_time = 0
            }
    };

    fs_write(fd, MCAP_MAGIC, sizeof(MCAP_MAGIC));
    mcap_write_header(&mcap_file, "data_log");
    return mcap_file;
}

uint8_t mcap_write_2bytes(struct fs_file_t* fd, uint16_t data) {
    ssize_t rc;
    data = sys_cpu_to_le16(data);
    rc = fs_write(fd, &data, sizeof(data));

//    if (rc < 0) {
//        LOG_ERR("FAIL: write %s: %d", fname, rc);
//    }
    return sizeof(data);
}

uint8_t mcap_write_4bytes(struct fs_file_t* fd, uint32_t data) {
    ssize_t rc;
    data = sys_cpu_to_le32(data);
    rc = fs_write(fd, &data, sizeof(data));

//    if (rc < 0) {
//        LOG_ERR("FAIL: write %s: %d", fname, rc);
//    }
    return sizeof(data);
}

uint8_t mcap_write_8bytes(struct fs_file_t* fd, uint64_t data) {
    ssize_t rc;
    data = sys_cpu_to_le64(data);
    rc = fs_write(fd, &data, sizeof(data));

//    if (rc < 0) {
//        LOG_ERR("FAIL: write %s: %d", fname, rc);
//    }
    return sizeof(data);
}

uint32_t mcap_write_record_preamble(struct fs_file_t* fd, uint8_t type, uint64_t len) {
    ssize_t rc;
    rc = fs_write(fd, &type, sizeof(type));
    len = sys_cpu_to_le64(len);
    rc = fs_write(fd, &len, sizeof(len));

//    if (rc < 0) {
//        LOG_ERR("FAIL: write %s: %d", fname, rc);
//    }
    return sizeof(len) + sizeof(type);
}

uint32_t mcap_write_string(struct fs_file_t* fd, const char * data) {
    // mcap string format: 4 bytes length, followed by the UTF8 bytes
    ssize_t rc;
    uint32_t len = strlen(data);
    mcap_write_4bytes(fd, len);
    rc = fs_write(fd, &data, len);
    return sizeof(len) + len;
}

uint16_t mcap_add_schema(struct mcap_file_t* mcap_file, const char* name, const char* encoding,
        const uint8_t* schema_buffer, uint32_t schema_len) {
    // schema IDs cannot be 0, so the first schema will be 1
    uint16_t schema_id = ++mcap_file->statistics.schema_count;
    uint64_t len = sizeof(schema_id) + mcap_string_length(name) + mcap_string_length(encoding) + sizeof(schema_len) + schema_len;
    mcap_file->fd_offset += mcap_write_record_preamble(mcap_file->fd, MCAP_TYPE_SCHEMA, len);
    mcap_file->fd_offset += mcap_write_2bytes(mcap_file->fd, schema_id);
    mcap_file->fd_offset += mcap_write_string(mcap_file->fd, name);
    mcap_file->fd_offset += mcap_write_string(mcap_file->fd, encoding);

    mcap_file->fd_offset += mcap_write_4bytes(mcap_file->fd, schema_len);
    ssize_t rc;
    rc = fs_write(mcap_file->fd, &schema_buffer, schema_len);
    mcap_file->fd_offset += schema_len;

    return schema_id;
}

uint16_t mcap_add_channel(struct mcap_file_t* mcap_file, uint16_t schema_id, const char* topic,
        const char* encoding, const struct mcap_metadata_t* metadata) {
    uint16_t channel_id = mcap_file->statistics.channel_count++;
    uint64_t len = sizeof(channel_id) + sizeof(schema_id) + mcap_string_length(topic) + mcap_string_length(encoding) + sizeof(struct mcap_metadata_t);
    mcap_file->fd_offset += mcap_write_record_preamble(mcap_file->fd, MCAP_TYPE_CHANNEL, len);
    mcap_file->fd_offset += mcap_write_2bytes(mcap_file->fd, channel_id);
    mcap_file->fd_offset += mcap_write_2bytes(mcap_file->fd, schema_id);
    mcap_file->fd_offset += mcap_write_string(mcap_file->fd, topic);
    mcap_file->fd_offset += mcap_write_string(mcap_file->fd, encoding);

    //mcap_file->fd_offset += mcap_write_metadata(mcap_file->fd, metadata);
    mcap_file->fd_offset += mcap_write_4bytes(mcap_file->fd, 0);
    return channel_id;
}

uint16_t mcap_write_message(struct mcap_file_t* mcap_file, uint16_t channel_id, uint32_t sequence,
        uint64_t log_time, uint64_t publish_time, const uint8_t* data, uint32_t len) {
    uint64_t record_len = sizeof(channel_id) + sizeof(sequence) + sizeof(log_time) + sizeof(publish_time) + len;
    mcap_file->fd_offset += mcap_write_record_preamble(mcap_file->fd, MCAP_TYPE_MESSAGE, record_len);
    mcap_write_2bytes(mcap_file->fd, channel_id);
    mcap_write_4bytes(mcap_file->fd, sequence);
    mcap_write_8bytes(mcap_file->fd, log_time);
    mcap_write_8bytes(mcap_file->fd, publish_time);

    ssize_t rc;
    rc = fs_write(mcap_file->fd, &data, len);
    mcap_file->fd_offset += record_len;

    return record_len;
}

void mcap_write_header(struct mcap_file_t* mcap_file, const char* profile) {
    uint64_t len = mcap_string_length(profile) + mcap_string_length(MCAP_LIBRARY);
    mcap_file->fd_offset += mcap_write_record_preamble(mcap_file->fd, MCAP_TYPE_HEADER, len);
    mcap_file->fd_offset += mcap_write_string(mcap_file->fd, profile);
    mcap_file->fd_offset += mcap_write_string(mcap_file->fd, MCAP_LIBRARY);
}

void mcap_write_statistics(struct mcap_file_t* mcap_file, uint32_t* crc) {
    // TODO CRC32 calculation
    uint64_t len = sizeof(struct mcap_statistics_t) + sizeof (uint32_t); // TODO channel_message_counts
    mcap_file->fd_offset += mcap_write_record_preamble(mcap_file->fd, MCAP_TYPE_STATISTICS, len);

    mcap_write_8bytes(mcap_file->fd, mcap_file->statistics.message_count);
    mcap_write_2bytes(mcap_file->fd, mcap_file->statistics.schema_count);
    mcap_write_4bytes(mcap_file->fd, mcap_file->statistics.channel_count);
    mcap_write_4bytes(mcap_file->fd, mcap_file->statistics.attachment_count);
    mcap_write_4bytes(mcap_file->fd, mcap_file->statistics.metadata_count);
    mcap_write_4bytes(mcap_file->fd, mcap_file->statistics.chunk_count);
    mcap_write_8bytes(mcap_file->fd, mcap_file->statistics.message_start_time);
    mcap_write_8bytes(mcap_file->fd, mcap_file->statistics.message_end_time);
    mcap_write_4bytes(mcap_file->fd, 0);  // TODO channel_message_counts

    mcap_file->fd_offset += len;
}

struct mcap_footer_t mcap_write_summary(struct mcap_file_t* mcap_file) {
    struct mcap_footer_t footer;

    footer.summary_start = mcap_file->fd_offset;
    footer.summary_offset_start = 0;
    footer.summary_crc = 0;
    
    mcap_write_statistics(mcap_file, &footer.summary_crc);

    return footer;
}

void mcap_write_footer(struct mcap_file_t* mcap_file, struct mcap_footer_t* footer) {
    mcap_file->fd_offset += mcap_write_record_preamble(mcap_file->fd, MCAP_TYPE_FOOTER, sizeof(struct mcap_footer_t));

    mcap_write_8bytes(mcap_file->fd, footer->summary_start);
    mcap_write_8bytes(mcap_file->fd, footer->summary_offset_start);
    mcap_write_4bytes(mcap_file->fd, footer->summary_crc);
}

void mcap_finish(struct mcap_file_t* mcap_file) {
    struct mcap_footer_t footer = mcap_write_summary(mcap_file);
    mcap_write_footer(mcap_file, &footer);
    fs_write(mcap_file->fd, MCAP_MAGIC, sizeof(MCAP_MAGIC));
}
```

## src/mcap.h
```c
#pragma once

#include <zephyr/kernel.h>
#include <zephyr/fs/fs.h>

// #define MCAP_ENCODING_

struct mcap_statistics_t {
    uint64_t message_count;
    uint16_t schema_count;
    uint32_t channel_count;
    uint32_t attachment_count;
    uint32_t metadata_count;
    uint32_t chunk_count;
    uint64_t message_start_time;
    uint64_t message_end_time;
    // uint16_t channel_message_counts[];
};

struct mcap_file_t {
    struct fs_file_t* fd;
    uint64_t fd_offset;
    struct mcap_statistics_t statistics;
};

struct mcap_metadata_t {
    uint32_t something;
};

struct mcap_footer_t {
    uint64_t summary_start;
    uint64_t summary_offset_start;
    uint32_t summary_crc;
};

// API
struct mcap_file_t mcap_init(struct fs_file_t* fd);
uint16_t mcap_add_schema(struct mcap_file_t* mcap_file, const char* name, const char* encoding, const uint8_t* schema_buffer, uint32_t schema_len);
uint16_t mcap_add_channel(struct mcap_file_t* mcap_file, uint16_t schema_id, const char* topic, const char* encoding, const struct mcap_metadata_t* metadata);
uint16_t mcap_write_message(struct mcap_file_t* mcap_file, uint16_t channel_id, uint32_t sequence, uint64_t log_time, uint64_t publish_time, const uint8_t* data, uint32_t len);
void mcap_finish(struct mcap_file_t* mcap_file);


uint32_t mcap_write_record_preamble(struct fs_file_t* fd, uint8_t type, uint64_t len);
void mcap_write_header(struct mcap_file_t* mcap_file, const char* profile);
//uint32_t mcap_write_string(int fd, const char * data);
void mcap_write_footer(struct mcap_file_t* mcap_file, struct mcap_footer_t* footer);
```
